## modules/button/drivers/button/Kconfig
```kconfig
#Create a new option in menuconfig
config CUSTOM_BUTTON
    bool "Custom button"
    default n # Default to 'no'
    depends on GPIO # Only show if GPIO support is enabled
    help
        Enable support for a custom button driver.
```

## modules/button/dts/bindings/input/custom,button.yaml
```yaml
# Description for the device
description: Button device with custom input binding

# Compatibility string that matches the one in the Devicetree source
# and DT_DRV_COMPAT macro in the driver source code
compatible: "custom,button"

# Define the required node properties
properties:
  pin:
    type: phandle
    required: true
```

## modules/print_lib/Kconfig
```kconfig
# Create a configuration for print_lib

config PRINT_LIB
    bool "Enable print_lib"
    default n
    depends on PRINTK
    help
      Enable the print_lib feature from the print_lib module.
```
