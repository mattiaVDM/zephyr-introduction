## CMakeLists.txt
```
cmake_minimum_required(VERSION 3.20.0)

set(ZEPHYR_EXTRA_MODULES "${CMAKE_SOURCE_DIR}/../../modules/print_lib")

find_package(Zephyr REQUIRED HINTS $ENV{ZEPHYR_BASE})
project(random)

target_sources(app PRIVATE src/main.c)
```

## prj.conf
```kconfig
# CONFIG_STACK_CANARIES is not set
CONFIG_STACK_POINTER_RANDOM=0
CONFIG_TEST_RANDOM_GENERATOR=y
CONFIG_TIMER_RANDOM_GENERATOR=y
CONFIG_TEST_CSPRNG_GENERATOR=y
```

## boards/esp32s3_devkitc.conf
```kconfig
# CONFIG_STACK_CANARIES is not set
CONFIG_STACK_POINTER_RANDOM=0
CONFIG_TEST_RANDOM_GENERATOR=y
CONFIG_TIMER_RANDOM_GENERATOR=y
CONFIG_TEST_CSPRNG_GENERATOR=y
CONFIG_PRINT_LIB=y
CONFIG_PICOLIBC_IO_FLOAT=y
# CONFIG_PICOLIBC_IO_LONG_LONG is not set
```

## src/main.c
```c
#include <zephyr/random/random.h>

#ifdef CONFIG_PRINT_LIB
#include "print_lib.h"
#endif

// Settings
static const int32_t sleep_time_ms = 1000;

int main(void)
{
    uint32_t rnd;
    double rnd_float;

    while (1) {

        rnd = sys_rand32_get();
		rnd_float = (double)rnd / (UINT32_MAX + 1.0);
		printk("Random number: %.3f\r\n", rnd_float);

#ifdef CONFIG_PRINT_LIB
        say_hello();
#endif

        // Sleep
        k_msleep(sleep_time_ms);
    }

    return 0;
}
```
